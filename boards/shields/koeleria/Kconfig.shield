## boards/shields/koeleria/Kconfig.shield
```kconfig
# No whitespace after the comma or in the keyboard name!
config SHIELD_KOELERIA_DONGLE
    def_bool $(shields_list_contains,koeleria_dongle)

# No whitespace after the comma or in your part name!
config SHIELD_KOELERIA_LEFT
    def_bool $(shields_list_contains,koeleria_left)

# No whitespace after the comma or in your part name!
config SHIELD_KOELERIA_RIGHT
    def_bool $(shields_list_contains,koeleria_right)
```
